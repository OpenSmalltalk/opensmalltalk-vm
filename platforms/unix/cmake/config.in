## processors/ARM/skyeye/misc/conf/configs/config.in
```kconfig
#
# For a description of the syntax of this configuration file,
# see _LINUX_SOURCE_DIR/Documentation/kbuild/config-language.txt.
#

mainmenu_name "SkyEye  Configuration"

# system wide options
mainmenu_option next_comment
comment 'Arch options'

choice 'ARM system type' \
        "ARM                  CONFIG_ARCH_ARM \
         Blackfin             CONFIG_ARCH_BLACKFIN \
         Coldfire        CONFIG_ARCH_COLDFIRE \
	 MIPS 		 CONFIG_ARCH_MIPS    " \ ARM
if [ "$CONFIG_ARCH_ARM" = "y" ]; then
	choice 'Machine type' \
	"AT91		CONFIG_MACH_AT91 \
	LPC2229		CONFIG_MACH_LPC2229 \
	S3C44b0		CONFIG_MACH_S3C44B0 \
	S3C4510		CONFIG_MACH_S3C4510 \
	EP7312		CONFIG_MACH_EP7312 \
	EP9312		CONFIG_MACH_EP9312 \
	AT91RM9200	CONFIG_MACH_RM9200 \
	S3C2410		CONFIG_MACH_2410 \
	StrongARM	CONFIG_MACH_STRONGARM \
	PXA255		CONFIG_MACH_PXA255 \
	PXA27x		CONFIG_MACH_PXA27x	" AT91
fi
dep_bool 'DBCT enable' CONFIG_DBCT $CONFIG_ARCH_ARM

endmenu

mainmenu_option next_comment
comment 'Memory bank options'
comment 'Memory bank1'
hex '  start address' CONFIG_MEMBANK1_START_ADDR 0
hex ' size'  CONFIG_MEMBANK1_SIZE 0
string 'type ' CONFIG_MEMBANK1_TYPE ""
bool "Load image file in this bank" CONFIG_MEMBANK1_LOAD
if ["$CONFIG_MEMBANK1_LOAD" = "y" ] ; then
	string "Image file path" CONFIG_MEMBANK1_FILE
fi
comment 'Memory Bank2 '
hex 'Start Address' CONFIG_MEMBANK2_START_ADDR 0
hex ' Size ' CONFIG_MEMBANK2_SIZE 0
string 'Type' CONFIG_MEMBANK2_TYPE ""
endmenu

# Netcard Simulation
mainmenu_option next_comment
comment 'Netcard Simulation'
bool 'Netcard simulation' CONFIG_NETCARD
hex 'Netcard Numbers' CONFIG_NETCARD_NUM
choice 'Netcard Mode' \
	" linux  CONFIG_NETCARD_LINUX_MOD \
	  tuntap CONFIG_NETCARD_TUNTAP_MOD \
	  win    CONFIG_NETCARD_WIN_MOD \
          vnet   CONFIG_NETCARD_VNET_MOD " tuntap
string 'Mac address' CONFIG_NETCARD_MAC_ADDR ""
string 'Host ip address' CONFIG_NETCARD_HOST_IP "10.0.0.1"
	
endmenu

# LCD engine options
mainmenu_option next_comment
comment 'LCD Simulation'
bool 'LCD simulation' CONFIG_LCD
hex 'Start Address' CONFIG_LCD1_START_ADDR 0
hex 'Size' CONFIG_LCD1_SIZE 0
choice 'LCD mode' \
	"gtk CONFIG_LCD_MOD_GTK" gtk
endmenu

#FLASH engine options
mainmenu_option next_comment
comment 'Flash Simulation'
bool 'Flash simulation' CONFIG_FLASH
endmenu

#log options
mainmenu_option next_comment
comment 'Log options'
bool 'Log enable' CONFIG_LOG
endmenu
```

## processors/ARM/skyeye/misc/conf/configs/defconfig
```kconfig
# default config file, made by mkdefconfig

#
# System wide options
#
CONFIG_LITE=n
CONFIG_STAND_ALONE=n
CONFIG_INCORE_RES=n
CONFIG_TIMERUNIT10MS=y
CONFIG_CURSORSUPPORT=y
CONFIG_MOVEABLE=y
CONFIG_DBCLK=y
CONFIG_DEBUG=n
CONFIG_TRACEMESSAGE=n
CONFIG_MSGSTR=n

#
# GAL engine options
#
CONFIG_NEWGAL=y
CONFIG_GAL_NATIVE=y
CONFIG_GAL_NATIVE_QVFB=y
CONFIG_GAL_NATIVE_COORTRANS_CW=n
CONFIG_GAL_NATIVE_COORTRANS_CCW=n
CONFIG_GAL_NATIVE_R1BPPFB=n
CONFIG_GAL_NATIVE_L1BPPFB=n
CONFIG_GAL_NATIVE_R2BPPFB=n
CONFIG_GAL_NATIVE_L2BPPFB=n
CONFIG_GAL_NATIVE_R4BPPFB=n
CONFIG_GAL_NATIVE_L4BPPFB=n
CONFIG_GAL_NATIVE_8BPPFB=y
CONFIG_GAL_NATIVE_16BPPFB=y
CONFIG_GAL_NATIVE_24BPPFB=n
CONFIG_GAL_NATIVE_32BPPFB=y
CONFIG_GAL_NATIVE_VGA16FB=n
CONFIG_GALIAL_SVGALIB=n
CONIFG_GALIAL_LIBGGI=n
CONFIG_GAL_EP7211=n
CONFIG_GAL_ADS=n
CONFIG_GAL_VGA16=n
CONFIG_NEWGAL_FBCON=y
CONFIG_NEWGAL_QVFB=y
CONFIG_NEWGAL_DUMMY=y

#
# IAL engine options
#
CONFIG_IAL_EP7211=n
CONFIG_IAL_ADS=n
CONFIG_IAL_IPAQ=n
CONFIG_IAL_MPC823=n
CONFIG_IAL_VR4181=n
CONFIG_IAL_HELIO=n
CONFIG_IAL_MTT800=n
CONFIG_IAL_DUMMY=y
CONFIG_IAL_NATIVE=y
CONFIG_IAL_MC68X328=n
CONFIG_IAL_NATIVE_PS2MOUSE=y
CONFIG_IAL_NATIVE_IMPS2MOUSE=y
CONFIG_IAL_NATIVE_MSMOUSE=y
CONFIG_IAL_NATIVE_MS3MOUSE=y
CONFIG_IAL_NATIVE_GPM=y

#
# Font options
#
CONFIG_FONT_RBF=y
CONFIG_FONT_INCOREGB12=y
CONFIG_FONT_VBF=y
CONFIG_FONT_INCORESSERIF=y
CONFIG_FONT_INCORECOURIER=y
CONFIG_FONT_INCORESYMBOL=y
CONFIG_FONT_INCOREVGAS=y
CONFIG_FONT_QPF=y
CONFIG_FONT_TTF=y
CONFIG_FONT_TYPE1=y

#
# Charset options
#
CONFIG_CHARSET_LATIN2=n
CONFIG_CHARSET_LATIN3=n
CONFIG_CHARSET_LATIN4=n
CONFIG_CHARSET_CYRILLIC=n
CONFIG_CHARSET_ARABIC=n
CONFIG_CHARSET_GREEK=n
CONFIG_CHARSET_HEBREW=n
CONFIG_CHARSET_LATIN5=n
CONFIG_CHARSET_LATIN6=n
CONFIG_CHARSET_THAI=n
CONFIG_CHARSET_LATIN7=n
CONFIG_CHARSET_LATIN8=n
CONFIG_CHARSET_LATIN9=y
CONFIG_CHARSET_LATIN10=n
CONFIG_CHARSET_GB2312=y
CONFIG_CHARSET_GBK=y
CONFIG_CHARSET_GB18030=n
CONFIG_CHARSET_BIG5=y
CONFIG_CHARSET_EUCKR=n
CONFIG_CHARSET_EUCJP=n
CONFIG_CHARSET_SHIFTJIS=n
CONFIG_CHARSET_UNICODE=y

#
# Keyboard layout specific options
#
CONFIG_KBD_FRPC=n
CONFIG_KBD_FR=n
CONFIG_KBD_DE=n
CONFIG_KBD_DELATIN1=n
CONFIG_KBD_IT=n
CONFIG_KBD_ES=n
CONFIG_KBD_ESCP850=n

#
# Image options
#
CONFIG_IMAGE_SAVEBMP=y
CONFIG_IMAGE_PCX=n
CONFIG_IMAGE_LBM=n
CONFIG_IMAGE_TGA=n
CONFIG_IMAGE_GIF=y
CONFIG_IMAGE_JPG=y
CONFIG_IMAGE_PNG=y

#
# Input method options
#
CONFIG_IME_GB2312=y
CONFIG_IME_GB2312PINYIN=y

#
# Appearance options
#
CONFIG_APPEARANCE_FLATSTYLE=n
CONFIG_APPEARANCE_TINYSCR=n

#
# Misc options
#
CONFIG_MISC_ABOUTDLG=y
CONFIG_MISC_SAVESCR=y
CONFIG_MISC_TEXTMODE=y

#
# Controls options
#
CONFIG_CTRL_STATIC=y
CONFIG_CTRL_BUTTON=y
CONFIG_CTRL_SIMEDIT=y
CONFIG_CTRL_SLEDIT=y
CONFIG_CTRL_MLEDIT=y
CONFIG_CTRL_LISTBOX=y
CONFIG_CTRL_PROGRESSBAR=y
CONFIG_CTRL_TOOLBAR=y
CONFIG_CTRL_NEWTOOLBAR=y
CONFIG_CTRL_MENUBUTTON=y
CONFIG_CTRL_TRACKBAR=y
CONFIG_CTRL_COMBOBOX=y
CONFIG_CTRL_PROPSHEET=y

#
# Ext library options
#
CONFIG_EXT_TREEVIEW=y
CONFIG_EXT_LISTVIEW=y
CONFIG_EXT_MONTHCAL=y
CONFIG_EXT_SPINBOX=y
CONFIG_EXT_COOLBAR=y
CONFIG_EXT_FULLGIF=n

CONFIG_PLATFORM_LINUX=y
CONFIG_COMPILER_X86=y
CONFIG_LIBC_GLIBC=y
```

## processors/ARM/skyeye/misc/conf/configs/mkdefconfig
```kconfig
#!/bin/sh
# This script is used to make the default config file: defconfig.

FEATURE_IN=feature.in
DEFCONFIG=defconfig

SAVEIFS=$IFS
IFS==


function check_def_yes () {
  if grep "$1" $CONFIGURE_HELP | grep "<default=yes>" > /dev/null; then
     return 0
  else
     return -1
  fi
}

echo "# default config file, made by mkdefconfig" > $DEFCONFIG
echo "" >> $DEFCONFIG

if [ -s $FEATURE_IN ]; then
  while read var_config feature
  do

    if [ "$feature" != "" ]; then
      if check_def_yes $feature; then
         echo $var_config=y >> $DEFCONFIG
      else
         echo $var_config=n >> $DEFCONFIG
      fi
    else
         echo $var_config >> $DEFCONFIG
    fi

  done < $FEATURE_IN
fi

echo \
"CONFIG_PLATFORM_LINUX=y
CONFIG_COMPILER_X86=y
CONFIG_LIBC_GLIBC=y" \
>> $DEFCONFIG


IFS=$SAVEIFS
```
